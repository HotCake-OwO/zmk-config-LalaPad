## config/west.yml
```yaml
manifest:
  remotes:
    - name: zmkfirmware
      url-base: https://github.com/zmkfirmware
    - name: ShiniNet
      url-base: https://github.com/ShiniNet/
    - name: caksoylar 
      url-base: https://github.com/caksoylar  
    #- name: the-via
    #  url-base: https://github.com
  projects:
    - name: zmk
      remote: zmkfirmware
      revision: v0.3.0
      import: app/west.yml
    - name: cirque-input-module
      remote: ShiniNet
      revision: main
    - name: zmk-rgbled-widget
      remote: caksoylar
      revision: v0.3
    #- name: zmk-input-processor-report-rate-limit
    #  remote: the-via
    #  revision: zephyr-3.5
    #  path: modules/zmk-input-processor-report-rate-limit
  self:
    path: config
```
